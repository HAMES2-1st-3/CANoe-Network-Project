/*@!Encoding:65001*/
includes
{
  
}

variables
{
  
}

on message CAN1.* //powertrain에서 메시지 받으면 body(CAN2)로 넘겨줌
{
  message *msg;
  
  msg=this; //현재 받은 메시지 그대로 msg에 넣어줌
  msg.can=2; // CAN2로 채널 변경
  
  output(msg);  //그대로 전송해줌(게이트웨이역할)
}